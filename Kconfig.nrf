## Kconfig.nrf
```kconfig
menu "nRF Projects"

rsource "subsys/Kconfig"
rsource "lib/Kconfig"
rsource "drivers/Kconfig"

endmenu
```

## applications/blinds/src/events/Kconfig
```kconfig
if LOG

menu "Event options"

comment "Initially logged events"

config BLINDS_INIT_LOG_MODULE_STATE_EVENT
	bool "Module state event"
	default y

endmenu

endif
```

## applications/blinds/src/hw_interface/Kconfig
```kconfig
menu "Hardware interface modules"

module = BLINDS_BOARD
module-str = board module
source "subsys/logging/Kconfig.template.log_config"

endmenu
```

## applications/controller/src/hw_interface/Kconfig
```kconfig
menu "Hardware interface modules"

#rsource "Kconfig.motion"
rsource "Kconfig.buttons"
#rsource "Kconfig.selector"
rsource "Kconfig.leds"
#rsource "Kconfig.battery_charger"
rsource "Kconfig.battery_meas"

module = CONTROLLER_BOARD
module-str = board module
source "subsys/logging/Kconfig.template.log_config"

endmenu
```

## applications/controller/src/hw_interface/Kconfig.battery_meas
```kconfig
menu "Battery measurement configuration"

choice
	prompt "Select battery measurement"
	default CONTROLLER_BATTERY_MEAS_NONE

config CONTROLLER_BATTERY_MEAS_NONE
	bool "No battery measurement"

config CONTROLLER_BATTERY_MEAS
	bool "Enable battery measurement circuit"

endchoice

config CONTROLLER_BATTERY_MEAS_MIN_LEVEL
	int "Minimum battery voltage [mV] that corresponds to 0% level"
	depends on CONTROLLER_BATTERY_MEAS
	default 3100

config CONTROLLER_BATTERY_MEAS_MAX_LEVEL
	int "Maximum battery voltage [mV] that corresponds to 100% level"
	depends on CONTROLLER_BATTERY_MEAS
	default 4180

config CONTROLLER_BATTERY_MEAS_HAS_VOLTAGE_DIVIDER
	bool "Use voltage divider for battery measurement"
	depends on CONTROLLER_BATTERY_MEAS

config CONTROLLER_BATTERY_MEAS_VOLTAGE_DIVIDER_UPPER
	int "Upper resistor in battery measurement voltage divider [kOhm]"
	depends on CONTROLLER_BATTERY_MEAS_HAS_VOLTAGE_DIVIDER
	help
	  Output voltage is measured on the lower resistor.

config CONTROLLER_BATTERY_MEAS_VOLTAGE_DIVIDER_LOWER
	int "Lower resistor in battery measurement voltage divider [kOhm]"
	depends on CONTROLLER_BATTERY_MEAS_HAS_VOLTAGE_DIVIDER
	help
	  Output voltage is measured on the lower resistor.

config CONTROLLER_VOLTAGE_TO_SOC_DELTA
	int "Difference between adjacent elements in conversion LUT [mV]"
	depends on CONTROLLER_BATTERY_MEAS
	default 10
	range 1 100
	help
	  Value used to convert battery voltage [mV] to State of Charge [%].

config CONTROLLER_BATTERY_MEAS_POLL_INTERVAL_MS
	int "Time between the subsequent battery measurements [ms]"
	depends on CONTROLLER_BATTERY_MEAS
	default 10000
	range 500 120000

config CONTROLLER_BATTERY_MEAS_HAS_ENABLE_PIN
	bool "Use pin for enabling battery measurement"
	depends on CONTROLLER_BATTERY_MEAS

config CONTROLLER_BATTERY_MEAS_ENABLE_PIN
	int "Battery monitoring enable pin"
	depends on CONTROLLER_BATTERY_MEAS
	default 255 if !CONTROLLER_BATTERY_MEAS_HAS_ENABLE_PIN
	help
	  A pin which enables the battery measurement circuit.

if CONTROLLER_BATTERY_MEAS
module = CONTROLLER_BATTERY_MEAS
module-str = battery measurement module
source "subsys/logging/Kconfig.template.log_config"
endif

endmenu
```

## applications/controller/src/modules/Kconfig
```kconfig
#rsource "Kconfig.power_manager"
rsource "Kconfig.hid_state"
#rsource "Kconfig.led_state"
#rsource "Kconfig.led_stream"
#rsource "Kconfig.shell"
#rsource "Kconfig.ble"
#rsource "Kconfig.hids"
#rsource "Kconfig.bas"
#rsource "Kconfig.config_channel"
#rsource "Kconfig.watchdog"
```

## applications/controller/src/modules/Kconfig.hids
```kconfig
menu "BLE HID Service"

config CONTROLLER_HID_MOUSE
	bool "Mouse HID device"
	help
	  This option controls if target is visible as mouse HID device.

config CONTROLLER_HID_KEYBOARD
	bool "Keyboard HID device"
	help
	  This option controls if target is visible as keyboard HID device.

config CONTROLLER_HID_CONSUMER_CTRL
	bool "Consumer control HID device"
	help
	  This option controls if target is visible as consumer control HID
	  device.

config CONTROLLER_HIDS_ENABLE
	bool
	help
	  This option enables HID over GATT service.

config CONTROLLER_HID_PERIPHERAL
	bool
	default y
	depends on BT_PERIPHERAL
	depends on (CONTROLLER_HID_MOUSE || CONTROLLER_HID_KEYBOARD || CONTROLLER_HID_CONSUMER_CTRL)
	select BT_GATT_HIDS
	select CONTROLLER_BAS_ENABLE
	select CONTROLLER_HIDS_ENABLE
	help
	  This option selects required options if device is HID peripheral.

if CONTROLLER_HIDS_ENABLE

module = CONTROLLER_HIDS
module-str = HID over GATT service
source "subsys/logging/Kconfig.template.log_config"

endif

endmenu
```

## applications/controller/src/modules/Kconfig.led_state
```kconfig
if CONTROLLER_LED_ENABLE

menu "LED state"

module = CONTROLLER_LED_STATE
module-str = LED state
source "subsys/logging/Kconfig.template.log_config"

endmenu

endif
```

## applications/hid_controller/src/hw_interface/Kconfig
```kconfig
menu "Hardware interface modules"

#rsource "Kconfig.motion"
rsource "Kconfig.buttons"
#rsource "Kconfig.click_detector"
rsource "Kconfig.selector"
#rsource "Kconfig.wheel"
rsource "Kconfig.leds"
#rsource "Kconfig.battery_charger"
rsource "Kconfig.battery_meas"
rsource "Kconfig.passkey"

module = CONTROLLER_BOARD
module-str = board module
source "subsys/logging/Kconfig.template.log_config"

endmenu
```

## applications/hid_controller/src/hw_interface/Kconfig.buttons
```kconfig
menu "Buttons configuration"

choice
	prompt "Select buttons interface"
	default CONTROLLER_BUTTONS_NONE

config CONTROLLER_BUTTONS_NONE
	bool "Disable buttons"

config CONTROLLER_BUTTONS_ENABLE
	bool "Buttons scanned from key matrix or directly connected GPIO"

config CONTROLLER_BUTTONS_SEESAW
	bool "Buttons scanned from Adafruit SeeSaw"

endchoice

config CONTROLLER_BUTTONS_SCAN_INTERVAL
	int "Buttons scan interval in ms"
	depends on CONTROLLER_BUTTONS_ENABLE
	default 2
	help
	  Interval at which key matrix is scanned.

config CONTROLLER_BUTTONS_DEBOUNCE_INTERVAL
	int "Interval before first button scan in ms"
	depends on CONTROLLER_BUTTONS_ENABLE
	default 2
	help
	  Interval before first scan. Introduced for debouncing reasons.

config CONTROLLER_BUTTONS_POLARITY_INVERSED
	bool "Inverse buttons polarity"
	depends on CONTROLLER_BUTTONS_ENABLE
	help
	  When this option is enabled, button is pressed when the GPIO state
	  is low.

config CONTROLLER_BUTTONS_EVENT_LIMIT
	int "Number of button events in single scan loop"
	depends on CONTROLLER_BUTTONS_ENABLE
	default 4
	range 0 255
	help
	  This option specifies the number of button events generated during
	  a single scanning loop. If more keys change state between scanning
	  intervals, subsequent changes will be ignored and picked up during
	  the next scanning.

if !CONTROLLER_BUTTONS_NONE
module = CONTROLLER_BUTTONS
module-str = buttons module
source "subsys/logging/Kconfig.template.log_config"
endif

endmenu
```

## applications/hid_controller/src/hw_interface/Kconfig.click_detector
```kconfig
menu "Click detector configuration"

config CONTROLLER_CLICK_DETECTOR_ENABLE
	bool "Enable click detector"
	depends on !CONTROLLER_BUTTONS_NONE

if CONTROLLER_CLICK_DETECTOR_ENABLE

module = CONTROLLER_CLICK_DETECTOR
module-str = click detector module
source "subsys/logging/Kconfig.template.log_config"

endif

endmenu
```

## applications/hid_controller/src/hw_interface/Kconfig.leds
```kconfig
menu "LEDs configuration"

config CONTROLLER_LED_ENABLE
	bool "Enable LED hardware interface"

config CONTROLLER_LED_COUNT
	int "Number of LEDs in use"
	depends on CONTROLLER_LED_ENABLE
	default 0

config CONTROLLER_LED_COLOR_COUNT
	int "Number of color channels per diode"
	depends on CONTROLLER_LED_ENABLE
	default 3

config CONTROLLER_LED_BRIGHTNESS_MAX
	int "Maximum value for LED brightness"
	depends on CONTROLLER_LED_ENABLE
	default 255

if CONTROLLER_LED_ENABLE
module = CONTROLLER_LED
module-str = LED module
source "subsys/logging/Kconfig.template.log_config"
endif

endmenu
```

## applications/hid_controller/src/hw_interface/Kconfig.passkey
```kconfig
menu "Passkey input configuration"

choice
	prompt "Select passkey input interface"
	default CONTROLLER_PASSKEY_NONE

config CONTROLLER_PASSKEY_NONE
	bool "Disable passkey"

config CONTROLLER_PASSKEY_BUTTONS
	bool "Passkey based on button presses"
	depends on !CONTROLLER_BUTTONS_NONE

endchoice

config CONTROLLER_PASSKEY_MAX_LEN
	int "Max number of digits in passkey"
	range 0 9
	default 0
	depends on !CONTROLLER_PASSKEY_NONE

if !CONTROLLER_PASSKEY_NONE

module = CONTROLLER_PASSKEY
module-str = passkey module
source "subsys/logging/Kconfig.template.log_config"

endif

endmenu
```

## applications/hid_controller/src/hw_interface/Kconfig.selector
```kconfig
menu "Selector configuration"

config CONTROLLER_SELECTOR_HW_ENABLE
	bool "Enable HW based selector"

if CONTROLLER_SELECTOR_HW_ENABLE

module = CONTROLLER_SELECTOR_HW
module-str = selector hw module
source "subsys/logging/Kconfig.template.log_config"

endif

endmenu
```

## applications/hid_controller/src/hw_interface/Kconfig.wheel
```kconfig
menu "Wheel configuration"
	depends on QDEC_NRFX

config CONTROLLER_WHEEL_ENABLE
	bool "Enable wheel hardware interface"
	depends on QDEC_NRFX

config CONTROLLER_WHEEL_SENSOR_VALUE_DIVIDER
	int "Wheel sensor value divider"
	depends on CONTROLLER_WHEEL_ENABLE
	range 1 2048
	default 1
	help
	  A value obtained from the wheel sensor will be divided
	  by provided argument before being processed further.

config CONTROLLER_WHEEL_SENSOR_IDLE_TIMEOUT
	int "Wheel sensor idle timeout"
	depends on CONTROLLER_WHEEL_ENABLE
	range 0 3600
	default 0
	help
	  Time in seconds before sensor goes to idle state.
	  If set to zero sensor is always active.

config CONTROLLER_WHEEL_INVERT_AXIS
	bool "Invert wheel axis"
	depends on CONTROLLER_WHEEL_ENABLE
	help
	  Switch the orientation of the wheel sensor.

if CONTROLLER_WHEEL_ENABLE
module = CONTROLLER_WHEEL
module-str = wheel module
source "subsys/logging/Kconfig.template.log_config"
endif

endmenu
```
