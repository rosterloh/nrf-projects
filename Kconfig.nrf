## applications/hid_controller/src/modules/Kconfig.ble
```kconfig
menu "BLE"

comment "BLE State"

config CONTROLLER_BLE_ENABLE_PASSKEY
	bool "Enable passkey based pairing"
	depends on !CONTROLLER_PASSKEY_NONE
	depends on BT_PERIPHERAL
	help
	  Enable passkey based pairing for increased security.

module = CONTROLLER_BLE_STATE
module-str = BLE state
source "subsys/logging/Kconfig.template.log_config"


comment "BLE Bond"

config CONTROLLER_BLE_USE_DEFAULT_ID
	bool "Use default Bluetooth local identity"
	depends on BT_PERIPHERAL
	help
	  Bluetooth default local identity is used as ID 0. This identity
	  cannot be reset. After bond for the default identity is removed,
	  it is not longer used.

config CONTROLLER_BLE_PEER_CONTROL
	bool "Enable interaction with peer configuration"
	depends on !CONTROLLER_BUTTONS_NONE
	help
	  Let user control Bluetooth peers by pressing a dedicated button.

if CONTROLLER_BLE_PEER_CONTROL

config CONTROLLER_BLE_PEER_CONTROL_BUTTON
	hex "Key ID of button used to control peers"
	range 0x0000 0xffff
	help
	  Button which should be used to control bonded Bluetooth peers.

config CONTROLLER_BLE_PEER_SELECT
	bool "Enable switching between peers"
	depends on BT_PERIPHERAL
	help
	  Short click to switch peer. Double click to accept choice.

config CONTROLLER_BLE_NEW_PEER_SCAN_REQUEST
	bool "Enable scanning on request"
	depends on BT_CENTRAL
	help
	  Short click to start new peer scanning. When enabled the device will
	  look for non-bonded devices only when requested.
	  When disabled the device always search for non-bonded devices while
	  scanning.
	  Regardless of the choice made the device scans periodically for
	  already bonded peers.

config CONTROLLER_BLE_NEW_PEER_SCAN_ON_BOOT
	bool "Look for peers after boot"
	depends on CONTROLLER_BLE_NEW_PEER_SCAN_REQUEST
	help
	  When enabled the device will look for new peers also after it was
	  booted.

config CONTROLLER_BLE_PEER_ERASE
	bool "Enable peer erase"
	help
	  Long click to start erase. Double click to confirm.

config CONTROLLER_BLE_PEER_ERASE_ON_START
	bool "Enable peer erase (on system start)"
	depends on BT_PERIPHERAL
	help
	  Hold dedicated button during system start to erase peer.
endif

if !CONTROLLER_BLE_PEER_CONTROL

config CONTROLLER_BLE_PEER_CONTROL_BUTTON
	hex
	default 0x0000

endif

config CONTROLLER_BLE_DONGLE_PEER_ENABLE
	bool "Enable dongle peer"
	help
	  Enable additional peer to connect with dongle.

config CONTROLLER_BLE_DONGLE_PEER_SELECTOR_ID
	int "Dongle peer selector ID"
	range 0 255
	default 0

config CONTROLLER_BLE_DONGLE_PEER_SELECTOR_POS
	int "Dongle peer selector position"
	range 0 255
	default 0

module = CONTROLLER_BLE_BOND
module-str = BLE bonds
source "subsys/logging/Kconfig.template.log_config"


comment "BLE Advertising"

config CONTROLLER_BLE_ADVERTISING_ENABLE
	bool "Enable BLE advertising"
	depends on BT_PERIPHERAL
	help
	  Make device discoverable via BLE.

config CONTROLLER_BLE_SHORT_NAME
	string "Short device name used for advertising"
	default ""
	depends on CONTROLLER_BLE_ADVERTISING_ENABLE

config CONTROLLER_BLE_DIRECT_ADV_AVAILABLE
	bool
	default y if BT_PERIPHERAL
	default y if BT_CENTRAL && BT_SCAN_WITH_IDENTITY

config CONTROLLER_BLE_DIRECT_ADV
	bool "Advertise to bonded peer directly"
	depends on CONTROLLER_BLE_ADVERTISING_ENABLE
	depends on CONTROLLER_BLE_DIRECT_ADV_AVAILABLE
	help
	  Device will use direct advertising if bonded.

config CONTROLLER_BLE_FAST_ADV
	bool "Enable period of fast advertising"
	depends on CONTROLLER_BLE_ADVERTISING_ENABLE
	help
	  Device will initially advertise with shorter interval.

config CONTROLLER_BLE_FAST_ADV_TIMEOUT
	int "Time of initial fast advertising [s]"
	default 30
	depends on CONTROLLER_BLE_FAST_ADV
	help
	  Device will initially advertise with shorter interval to enable
	  quicker discovery by hosts. After this time it will shift to normal
	  cadence advertising.

config CONTROLLER_BLE_SWIFT_PAIR
	bool "Enable Swift Pair feature"
	depends on CONTROLLER_BLE_ADVERTISING_ENABLE
	depends on CONTROLLER_BLE_FAST_ADV
	help
	  Enable quick pairing with Microsoft Swift Pair.

config CONTROLLER_BLE_SWIFT_PAIR_GRACE_PERIOD
	int "No Swift Pair time gap before suspend [s]"
	default 30
	depends on CONTROLLER_POWER_MANAGER_ENABLE
	depends on CONTROLLER_BLE_SWIFT_PAIR
	help
	  To ensure users will not try to connect to a device which is no longer
	  available, Swift Pair vendor section will be removed before exiting
	  from advertising mode.

if CONTROLLER_BLE_ADVERTISING_ENABLE

module = CONTROLLER_BLE_ADV
module-str = BLE advertising
source "subsys/logging/Kconfig.template.log_config"

endif


comment "BLE Scanning"

config CONTROLLER_BLE_SCANNING_ENABLE
	bool "Enable BLE scanning"
	default n
	depends on BT_CENTRAL
	help
	  Enable device to scan for peripheral devices.

config CONTROLLER_BLE_SCAN_START_TIMEOUT_S
	int "Scan start timeout [s]"
	default 5
	depends on CONTROLLER_BLE_SCANNING_ENABLE
	help
	  After disabled, scanning is re-enabled after defined time of connected
	  peripherals inactivity (scanning has negative impact on user
	  experience - e.g. may cause mouse pointer lags).

config CONTROLLER_BLE_SCAN_DURATION_S
	int "Scan duration [s]"
	default 5
	depends on CONTROLLER_BLE_SCANNING_ENABLE
	help
	  After this time scan is disabled if any peripheral is connected.

if CONTROLLER_BLE_SCANNING_ENABLE

module = CONTROLLER_BLE_SCANNING
module-str = BLE scanning
source "subsys/logging/Kconfig.template.log_config"

endif


comment "BLE Discovery"

config CONTROLLER_BLE_DISCOVERY_ENABLE
	bool "Enable BLE discovery"
	depends on CONTROLLER_BLE_SCANNING_ENABLE
	help
	  Enable device to read Device Information Service and discover HIDS.

if CONTROLLER_BLE_DISCOVERY_ENABLE

module = CONTROLLER_BLE_DISCOVERY
module-str = BLE discovery
source "subsys/logging/Kconfig.template.log_config"

endif

comment "BLE Latency"

if BT_PERIPHERAL

config CONTROLLER_BLE_SECURITY_FAIL_TIMEOUT_S
	int "Security fail timeout [s]"
	default 10
	help
	  After this time peripheral device disconnects if security is not
	  established.

module = CONTROLLER_BLE_LATENCY
module-str = BLE latency
source "subsys/logging/Kconfig.template.log_config"

endif

comment "BLE QoS management"

config CONTROLLER_BLE_QOS_ENABLE
	bool "Enable BLE channel map management"
	depends on BT_CENTRAL
	depends on BT_LL_NRFXLIB
	select BT_HCI_VS_EVT_USER
	help
	  Enable device to avoid congested RF channels.

config CONTROLLER_BLE_QOS_INTERVAL
	int "Processing interval for QoS thread [ms]"
	default 1000
	depends on CONTROLLER_BLE_QOS_ENABLE
	help
	  Configure processing interval for QoS algorithm.
	  Longer intervals means more time to accumulate CRC stats,
	  and vice versa.

config CONTROLLER_BLE_QOS_STACK_SIZE
	int "Base stack size for QoS thread"
	default 240
	depends on CONTROLLER_BLE_QOS_ENABLE
	help
	  Configure base stack size for QoS processing thread.

config CONTROLLER_BLE_QOS_STATS_PRINTOUT_ENABLE
	bool "Enable BLE QoS statistics printout"
	depends on CONTROLLER_BLE_QOS_ENABLE
	select USB_COMPOSITE_DEVICE
	select USB_CDC_ACM
	select SERIAL
	select UART_LINE_CTRL
	select UART_INTERRUPT_DRIVEN
	help
	  Enable to get real-time QoS information printouts via CDC ACM.

config CONTROLLER_BLE_QOS_STATS_PRINT_STACK_SIZE
	int "Stack size addition for QoS printout"
	default 784
	depends on CONTROLLER_BLE_QOS_STATS_PRINTOUT_ENABLE
	help
	  This size increase is added to the QoS base stack size
	  to facilitate statistics printout.

if CONTROLLER_BLE_QOS_ENABLE

module = CONTROLLER_BLE_QOS
module-str = BLE channel map management
source "subsys/logging/Kconfig.template.log_config"

endif

endmenu
```

## applications/hid_controller/src/modules/Kconfig.config_channel
```kconfig
menu "User configuration channel"

config CONTROLLER_CONFIG_CHANNEL_ENABLE
	bool "Enable user configuration channel"
	help
	  Enables user to change firmware parameters at runtime over the
	  configuration channel.

config CONTROLLER_CONFIG_CHANNEL_TIMEOUT
	int "Transaction timeout on configuration channel in seconds"
	depends on CONTROLLER_CONFIG_CHANNEL_ENABLE
	default 10

if CONTROLLER_CONFIG_CHANNEL_ENABLE

module = CONTROLLER_CONFIG_CHANNEL
module-str = Config channel
source "subsys/logging/Kconfig.template.log_config"

module = CONTROLLER_INFO
module-str = Info
source "subsys/logging/Kconfig.template.log_config"

endif

config CONTROLLER_CONFIG_CHANNEL_DFU_ENABLE
	bool "DFU over the config channel"
	depends on CONTROLLER_CONFIG_CHANNEL_ENABLE
	help
	  This option enables DFU over the config channel.

if CONTROLLER_CONFIG_CHANNEL_DFU_ENABLE

module = CONTROLLER_CONFIG_CHANNEL_DFU
module-str = Config channel DFU
source "subsys/logging/Kconfig.template.log_config"

endif

endmenu
```

## applications/hid_controller/src/modules/Kconfig.hid
```kconfig
menu "HID"

config CONTROLLER_HID_REPORT_DESC
	string "HID report descriptor"
	default ""
	help
	  This option specifies a path to the HID report descriptor file.

config CONTROLLER_HID_MOUSE
	bool "Device is a HID mouse"
	select CONTROLLER_HID_REPORT_MOUSE_SUPPORT
	help
	  Enable reports needed by a mouse.

config CONTROLLER_HID_KEYBOARD
	bool "Device is a HID keyboard"
	select CONTROLLER_HID_REPORT_KEYBOARD_SUPPORT
	select CONTROLLER_HID_REPORT_SYSTEM_CTRL_SUPPORT
	select CONTROLLER_HID_REPORT_CONSUMER_CTRL_SUPPORT
	help
	  Enable reports needed by a keyboard.

config CONTROLLER_HID_DONGLE
	bool "Device is a HID keyboard"
	select CONTROLLER_HID_REPORT_MOUSE_SUPPORT
	select CONTROLLER_HID_REPORT_KEYBOARD_SUPPORT
	select CONTROLLER_HID_REPORT_SYSTEM_CTRL_SUPPORT
	select CONTROLLER_HID_REPORT_CONSUMER_CTRL_SUPPORT
	help
	  Enable reports needed by a dongle.

menu "HID Reports"

config CONTROLLER_HID_REPORT_MOUSE_SUPPORT
	bool "Mouse report support"
	help
	  This option controls if the device supports HID mouse report.
	  Report is added to the report map. It does not need to be generated
	  by the device.

config CONTROLLER_HID_REPORT_KEYBOARD_SUPPORT
	bool "Keyboard report support"
	help
	  This option controls if the device supports HID keyboard reports.
	  Report is added to the report map. It does not need to be generated
	  by the device.

config CONTROLLER_HID_REPORT_SYSTEM_CTRL_SUPPORT
	bool "System control report support"
	help
	  This option controls if the device supports HID system control report.
	  Report is added to the report map. It does not need to be generated
	  by the device.

config CONTROLLER_HID_REPORT_CONSUMER_CTRL_SUPPORT
	bool "Consumer control report support"
	help
	  This option controls if the device supports HID consumer control
	  report.
	  Report is added to the report map. It does not need to be generated
	  by the device.

endmenu


choice
	prompt "Select boot protocol interface"
	default CONTROLLER_HID_BOOT_INTERFACE_DISABLED

config CONTROLLER_HID_BOOT_INTERFACE_DISABLED
	bool "Boot interface disabled"
	help
	  Device will not provide any boot interface.

config CONTROLLER_HID_BOOT_INTERFACE_MOUSE
	bool "Boot interface mouse"
	depends on CONTROLLER_HID_REPORT_MOUSE_SUPPORT
	help
	  Device will use the mouse boot report.

config CONTROLLER_HID_BOOT_INTERFACE_KEYBOARD
	bool "Boot interface keyboard"
	depends on CONTROLLER_HID_REPORT_KEYBOARD_SUPPORT
	help
	  Device will use the keyboard boot report.

endchoice


endmenu
```

## applications/hid_controller/src/modules/Kconfig.hid_state
```kconfig
menu "HID State"

config CONTROLLER_HID_STATE_ENABLE
	bool "Enable HID state"
	help
	  HID events processing module.

if CONTROLLER_HID_STATE_ENABLE

config CONTROLLER_HID_REPORT_EXPIRATION
	int "HID report expiration [ms]"
	default 500
	help
	  Define the time after which a HID report expires
	  and is not sent again.

config CONTROLLER_HID_EVENT_QUEUE_SIZE
	int "HID event queue size"
	default 12
	range 2 255

module = CONTROLLER_HID_STATE
module-str = HID state
source "subsys/logging/Kconfig.template.log_config"

endif

endmenu
```

## applications/hid_controller/src/modules/Kconfig.hids
```kconfig
menu "BLE HID Service"

config CONTROLLER_HIDS_ENABLE
	bool
	help
	  This option enables HID over GATT service.

config CONTROLLER_HID_PERIPHERAL
	bool
	default y
	depends on BT_PERIPHERAL
	select BT_GATT_HIDS
	select CONTROLLER_BAS_ENABLE
	select CONTROLLER_HIDS_ENABLE
	help
	  This option selects required options if device is HID peripheral.

if CONTROLLER_HIDS_ENABLE

config CONTROLLER_HIDS_FIRST_REPORT_DELAY
	int "First HID report delay [ms]"
	default 0
	range 0 2000
	help
	  If set to non-zero, the peripheral will delay sending first HID
	  report after the connection security was established. This is done to
	  ensure that central will be ready to receive the data. nRF Desktop
	  centrals reenable the subscriptions on every reconnection. HID report
	  is dropped if received before the subscription was reenabled.

module = CONTROLLER_HIDS
module-str = HID over GATT service
source "subsys/logging/Kconfig.template.log_config"

endif

endmenu
```

## applications/hid_controller/src/modules/Kconfig.led_stream
```kconfig
menu "LED stream"

config CONTROLLER_LED_STREAM_ENABLE
	bool "Enable LED stream"
	depends on CONTROLLER_LED_ENABLE && CONTROLLER_CONFIG_CHANNEL_ENABLE
	help
	  Enable RGB LED effect streaming.

config CONTROLLER_LED_STREAM_QUEUE_SIZE
	int "Stream led event queue size"
	depends on CONTROLLER_LED_ENABLE && CONTROLLER_CONFIG_CHANNEL_ENABLE
	default 15
	range 2 254

if CONTROLLER_LED_STREAM_ENABLE

module = CONTROLLER_LED_STREAM
module-str = LED stream
source "subsys/logging/Kconfig.template.log_config"

endif

endmenu
```

## applications/hid_controller/src/modules/Kconfig.shell
```kconfig
if SHELL

menu "Shell module"

config CONTROLLER_SHELL_ENABLE
	bool "Enable shell module"
	default n
	depends on SHELL

config CONTROLLER_DEVICE_SHELL
	bool "Enable device information"
	depends on CONTROLLER_SHELL_ENABLE
	default n
	select DEVICE_SHELL

config CONTROLLER_KERNEL_SHELL
	bool "Enable kernel information"
	depends on CONTROLLER_SHELL_ENABLE
	select KERNEL_SHELL
	select THREAD_MONITOR
	select INIT_STACKS
	select THREAD_NAME

endmenu

endif
```

## applications/hid_controller/src/modules/Kconfig.usb_state
```kconfig
if USB_DEVICE_HID

menu "USB state"

config CONTROLLER_USB_ENABLE
	bool "Enable USB module"
	help
	  Enables USB module.

if CONTROLLER_USB_ENABLE

module = CONTROLLER_USB_STATE
module-str = USB state
source "subsys/logging/Kconfig.template.log_config"

endif

endmenu

endif
```

## applications/hid_controller/src/modules/Kconfig.watchdog
```kconfig
menu "Watchdog settings"

config CONTROLLER_WATCHDOG_ENABLE
	bool "Enable watchdog support"
	depends on WATCHDOG
	help
	  Enable watchdog to reset the device in case of problems.

if CONTROLLER_WATCHDOG_ENABLE

config CONTROLLER_WATCHDOG_TIMEOUT
	int "Watchdog timeout value [ms]"
	default 500
	range 500 120000
	help
	  Timeout of watchdog timer. After the time elapse a device will be restarted.

module = CONTROLLER_WATCHDOG
module-str = watchdog
source "subsys/logging/Kconfig.template.log_config"

endif

endmenu
```

## applications/mesh_bridge/src/events/Kconfig
```kconfig
if LOG

menu "Event options"

comment "Initially logged events"

config BRIDGE_LOG_MODULE_STATE_EVENT
	bool "Module state event"
	default y

config BRIDGE_LOG_UART_DATA_EVENT
	bool "UART data event"
	default y

config BRIDGE_LOG_CDC_DATA_EVENT
	bool "CDC data event"
	default y

config BRIDGE_LOG_POWER_DOWN_EVENT
	bool "Power down event"
	default y

endmenu

endif
```
