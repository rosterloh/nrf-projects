## CMakeLists.txt
```
cmake_minimum_required(VERSION 3.13.1)
include($ENV{ZEPHYR_BASE}/cmake/app/boilerplate.cmake NO_POLICY_SCOPE)
project("Mesh LEDs"
        VERSION 0.1)

target_sources(app PRIVATE
	src/main.c
	src/prov_handler.c
	src/model_handler.c)
target_include_directories(app PRIVATE include)
```

## prj.conf
```kconfig
# General configuration
CONFIG_MAIN_STACK_SIZE=4096
CONFIG_SYSTEM_WORKQUEUE_STACK_SIZE=4096
CONFIG_FLASH=y
CONFIG_FLASH_MAP=y
CONFIG_FCB=y
CONFIG_SETTINGS=y
CONFIG_HWINFO=y
CONFIG_LOG=y
CONFIG_LOG_PRINTK=y

# Bluetooth configuration
CONFIG_BT=y
CONFIG_BT_CTLR_COMPANY_ID=0x0059
CONFIG_BT_DEVICE_NAME="Mesh LEDs"
CONFIG_BT_L2CAP_TX_MTU=69
CONFIG_BT_L2CAP_TX_BUF_COUNT=32
CONFIG_BT_LL_SW_SPLIT=y
CONFIG_BT_OBSERVER=y
CONFIG_BT_PERIPHERAL=y
CONFIG_BT_SETTINGS=y

# Disable unused Bluetooth features
CONFIG_BT_CTLR_DUP_FILTER_LEN=0
CONFIG_BT_CTLR_LE_ENC=n
CONFIG_BT_DATA_LEN_UPDATE=n
CONFIG_BT_PHY_UPDATE=n
CONFIG_BT_CTLR_CHAN_SEL_2=n
CONFIG_BT_CTLR_MIN_USED_CHAN=n
CONFIG_BT_CTLR_PRIVACY=n

# Bluetooth Mesh configuration
CONFIG_BT_MESH=y
CONFIG_BT_MESH_RELAY=y
CONFIG_BT_MESH_FRIEND=y
CONFIG_BT_MESH_ADV_BUF_COUNT=64
CONFIG_BT_MESH_TX_SEG_MAX=32
CONFIG_BT_MESH_PB_GATT=y
CONFIG_BT_MESH_GATT_PROXY=y

# Bluetooth Mesh models
CONFIG_BT_MESH_ONOFF_SRV=y
```

## src/main.c
```c
#include <bluetooth/bluetooth.h>
#include <bluetooth/mesh/models.h>
#include <dk_buttons_and_leds.h>
#include "prov_handler.h"
#include "model_handler.h"

void main(void)
{
	int err;

	dk_leds_init();

	err = bt_enable(NULL);
	if (err) {
		printk("Bluetooth init failed (err %d)\n", err);
		return;
	}

	err = bt_mesh_init(prov_handler_init(), model_handler_init());
	if (err) {
		printk("Initializing mesh failed (err %d)\n", err);
		return;
	}

	if (IS_ENABLED(CONFIG_SETTINGS)) {
		settings_load();
	}

	/* This will be a no-op if settings_load() loaded provisioning info */
	bt_mesh_prov_enable(BT_MESH_PROV_ADV | BT_MESH_PROV_GATT);

	printk("Mesh initialized\n");
}
```

## include/model_handler.h
```c
#ifndef MODEL_HANDLER_H__
#define MODEL_HANDLER_H__

#include <bluetooth/mesh.h>

#ifdef __cplusplus
extern "C" {
#endif

const struct bt_mesh_comp *model_handler_init(void);

#ifdef __cplusplus
}
#endif

#endif /* MODEL_HANDLER_H__ */
```

## include/prov_handler.h
```c
#ifndef PROV_HANDLER_H__
#define PROV_HANDLER_H__

#include <bluetooth/mesh.h>

#ifdef __cplusplus
extern "C" {
#endif

const struct bt_mesh_prov *prov_handler_init(void);

#ifdef __cplusplus
}
#endif

#endif /* PROV_HANDLER_H__ */
```

## src/app_ledstrip.c
```c
#include <string.h>
#include <misc/printk.h>
#include <drivers/led_strip.h>
#include <drivers/gpio.h>

#define GPIO_OUT_DRV_NAME "GPIO_0"
#define GPIO_PWR_EN  25
#define STRIP_NUM_LEDS 4

static struct device *strip;
static size_t ledstrip_counter = 0;

static const struct led_rgb colors[] = {
    {.r = 0x1f,.g = 0x00,.b = 0x00, },	/* red */
    {.r = 0x00,.g = 0x1f,.b = 0x00, },	/* green */
    {.r = 0x00,.g = 0x00,.b = 0x1f, },	/* blue */
};

static const struct led_rgb black = {
    .r = 0x00,
    .g = 0x00,
    .b = 0x00,
};

struct led_rgb strip_colors[STRIP_NUM_LEDS];

const struct led_rgb *color_at(size_t time, size_t i)
{
    size_t rgb_start = time % STRIP_NUM_LEDS;

    if (rgb_start <= i && i < rgb_start + ARRAY_SIZE(colors)) {
	return &colors[i - rgb_start];
    } else {
	return &black;
    }
}

int app_ledstrip_setup(void)
{
    struct device *gpio_out_dev;
    int ret;

    gpio_out_dev = device_get_binding(GPIO_OUT_DRV_NAME);
    if (!gpio_out_dev) {
	printk("Cannot find %s!\n", GPIO_OUT_DRV_NAME);
	return -1;
    }

    /* GPIO output */
    ret = gpio_pin_configure(gpio_out_dev, GPIO_PWR_EN, (GPIO_DIR_OUT));
    if (ret) {
	printk("Error configuring GPIO (err %d)\n", ret);
	return ret;
    }
    printk("Turning on 5V_LED Rail %d\n", GPIO_PWR_EN);

    ret = gpio_pin_write(gpio_out_dev, GPIO_PWR_EN, 1);
    if (ret) {
	printk("Error writing GPIO (err %d)\n", ret);
	return ret;
    }

    /* APA102 Strip */
    strip = device_get_binding(DT_APA_APA102_0_LABEL);
    if (!strip) {
	printk("Cannot find %s!\n", GPIO_OUT_DRV_NAME);
	return -1;
    }

    ledstrip_counter = 0;

    return 0;
}

int app_ledstrip_run(void) {
    size_t i;
    for (i = 0; i < STRIP_NUM_LEDS; i++) {
	memcpy(&strip_colors[i], color_at(ledstrip_counter, i),
	   sizeof(strip_colors[i]));
    }
    led_strip_update_rgb(strip, strip_colors, STRIP_NUM_LEDS);
    ledstrip_counter++;
    return 0;
}
```

## src/model_handler.c
```c
#include <bluetooth/bluetooth.h>
#include <bluetooth/mesh/models.h>
#include <dk_buttons_and_leds.h>
#include "model_handler.h"

static void led_set(struct bt_mesh_onoff_srv *srv, struct bt_mesh_msg_ctx *ctx,
		    const struct bt_mesh_onoff_set *set,
		    struct bt_mesh_onoff_status *rsp);

static void led_get(struct bt_mesh_onoff_srv *srv, struct bt_mesh_msg_ctx *ctx,
		    struct bt_mesh_onoff_status *rsp);

static const struct bt_mesh_onoff_srv_handlers onoff_handlers = {
	.set = led_set,
	.get = led_get,
};

struct led_ctx {
	struct bt_mesh_onoff_srv srv;
	struct k_delayed_work work;
	u32_t remaining;
	bool value;
};

static struct led_ctx led_ctx[4] = {
	[0 ... 3] = {
		.srv = BT_MESH_ONOFF_SRV_INIT(&onoff_handlers),
	}
};

static void led_transition_start(struct led_ctx *led)
{
	int led_idx = led - &led_ctx[0];

	/* As long as the transition is in progress, the onoff
	 * state is "on":
	 */
	dk_set_led(led_idx, true);
	k_delayed_work_submit(&led->work, led->remaining);
	led->remaining = 0;
}

static void led_status(struct led_ctx *led, struct bt_mesh_onoff_status *status)
{
	status->remaining_time =
		k_delayed_work_remaining_get(&led->work) + led->remaining;
	status->target_on_off = led->value;
	/* As long as the transition is in progress, the onoff state is "on": */
	status->present_on_off = led->value || status->remaining_time;
}

static void led_set(struct bt_mesh_onoff_srv *srv, struct bt_mesh_msg_ctx *ctx,
		    const struct bt_mesh_onoff_set *set,
		    struct bt_mesh_onoff_status *rsp)
{
	struct led_ctx *led = CONTAINER_OF(srv, struct led_ctx, srv);
	int led_idx = led - &led_ctx[0];

	if (set->on_off == led->value) {
		goto respond;
	}

	led->value = set->on_off;
	led->remaining = set->transition->time;

	if (set->transition->delay > 0) {
		k_delayed_work_submit(&led->work, set->transition->delay);
	} else if (set->transition->time > 0) {
		led_transition_start(led);
	} else {
		dk_set_led(led_idx, set->on_off);
	}

respond:
	if (rsp) {
		led_status(led, rsp);
	}
}

static void led_get(struct bt_mesh_onoff_srv *srv, struct bt_mesh_msg_ctx *ctx,
		    struct bt_mesh_onoff_status *rsp)
{
	struct led_ctx *led = CONTAINER_OF(srv, struct led_ctx, srv);

	led_status(led, rsp);
}

static void led_work(struct k_work *work)
{
	struct led_ctx *led = CONTAINER_OF(work, struct led_ctx, work.work);
	int led_idx = led - &led_ctx[0];

	if (led->remaining) {
		led_transition_start(led);
	} else {
		dk_set_led(led_idx, led->value);

		/* Publish the new value at the end of the transition */
		struct bt_mesh_onoff_status status;

		led_status(led, &status);
		bt_mesh_onoff_srv_pub(&led->srv, NULL, &status);
	}
}

/** Configuration server definition */
static struct bt_mesh_cfg_srv cfg_srv = {
	.relay = IS_ENABLED(CONFIG_BT_MESH_RELAY),
	.beacon = BT_MESH_BEACON_ENABLED,
	.frnd = IS_ENABLED(CONFIG_BT_MESH_FRIEND),
	.gatt_proxy = IS_ENABLED(CONFIG_BT_MESH_GATT_PROXY),
	.default_ttl = 7,

	/* 3 transmissions with 20ms interval */
	.net_transmit = BT_MESH_TRANSMIT(2, 20),
	.relay_retransmit = BT_MESH_TRANSMIT(2, 20),
};

/* Set up a repeating delayed work to blink the DK's LEDs when attention is
 * requested.
 */
static struct k_delayed_work attention_blink_work;

static void attention_blink(struct k_work *work)
{
	static int idx;
	const u8_t pattern[] = {
		BIT(0) | BIT(1),
		BIT(1) | BIT(2),
		BIT(2) | BIT(3),
		BIT(3) | BIT(0),
	};
	dk_set_leds(pattern[idx++ % ARRAY_SIZE(pattern)]);
	k_delayed_work_submit(&attention_blink_work, 30);
}

static void attention_on(struct bt_mesh_model *mod)
{
	k_delayed_work_submit(&attention_blink_work, 0);
}

static void attention_off(struct bt_mesh_model *mod)
{
	k_delayed_work_cancel(&attention_blink_work);
	dk_set_leds(DK_NO_LEDS_MSK);
}

static const struct bt_mesh_health_srv_cb health_srv_cb = {
	.attn_on = attention_on,
	.attn_off = attention_off,
};

static struct bt_mesh_health_srv health_srv = {
	.cb = &health_srv_cb,
};

BT_MESH_HEALTH_PUB_DEFINE(health_pub, 0);

#define BT_MESH_MODEL_LIST(...) ((struct bt_mesh_model[]){ __VA_ARGS__ })

static struct bt_mesh_elem elements[] = {
	BT_MESH_ELEM(
		1, BT_MESH_MODEL_LIST(
			BT_MESH_MODEL_CFG_SRV(&cfg_srv),
			BT_MESH_MODEL_HEALTH_SRV(&health_srv, &health_pub),
			BT_MESH_MODEL_ONOFF_SRV(&led_ctx[0].srv)),
		BT_MESH_MODEL_NONE),
	BT_MESH_ELEM(
		2, BT_MESH_MODEL_LIST(BT_MESH_MODEL_ONOFF_SRV(&led_ctx[1].srv)),
		BT_MESH_MODEL_NONE),
	BT_MESH_ELEM(
		3, BT_MESH_MODEL_LIST(BT_MESH_MODEL_ONOFF_SRV(&led_ctx[2].srv)),
		BT_MESH_MODEL_NONE),
	BT_MESH_ELEM(
		4, BT_MESH_MODEL_LIST(BT_MESH_MODEL_ONOFF_SRV(&led_ctx[3].srv)),
		BT_MESH_MODEL_NONE),
};

static const struct bt_mesh_comp comp = {
	.cid = CONFIG_BT_CTLR_COMPANY_ID,
	.elem = elements,
	.elem_count = ARRAY_SIZE(elements),
};

const struct bt_mesh_comp *model_handler_init(void)
{
	k_delayed_work_init(&attention_blink_work, attention_blink);

	for (int i = 0; i < ARRAY_SIZE(led_ctx); ++i) {
		k_delayed_work_init(&led_ctx[i].work, led_work);
	}

	return &comp;
}
```

## src/prov_handler.c
```c
#include <bluetooth/mesh.h>
#include <dk_buttons_and_leds.h>
#include <drivers/hwinfo.h>

static u32_t oob_toggles;
static u32_t oob_toggle_count;
static struct k_delayed_work oob_work;
static u32_t button_press_count;

static void oob_blink_toggle(struct k_work *work)
{
	dk_set_leds(((oob_toggle_count++) & 0x01) ? DK_NO_LEDS_MSK :
						    DK_ALL_LEDS_MSK);
	if (oob_toggle_count == oob_toggles) {
		oob_toggle_count = 0;
		k_delayed_work_submit(
			CONTAINER_OF(work, struct k_delayed_work, work), 3000);
	} else {
		k_delayed_work_submit(
			CONTAINER_OF(work, struct k_delayed_work, work), 250);
	}
}

static int output_number(bt_mesh_output_action_t action, u32_t number)
{
	if (action == BT_MESH_DISPLAY_NUMBER) {
		printk("OOB Number: %u\n", number);
	} else if (action == BT_MESH_BLINK) {
		printk("Blinking %u times\n", number);
		oob_toggles = number * 2;
		oob_toggle_count = 0;
		k_delayed_work_init(&oob_work, oob_blink_toggle);
		k_delayed_work_submit(&oob_work, 0);
	}
	return 0;
}


static void oob_button_timeout(struct k_work *work)
{
	dk_buttons_init(NULL);
	dk_set_leds(DK_NO_LEDS_MSK);

	bt_mesh_input_number(button_press_count);
}

static void oob_button_handler(u32_t button_state, u32_t has_changed)
{
	if (button_state & has_changed) {
		button_press_count++;
		dk_set_leds((1 << button_press_count) - 1);
		k_delayed_work_submit(&oob_work, 3000);
	}
}

static int input(bt_mesh_input_action_t act, u8_t size)
{
	printk("Press a button to set the right number.\n");
	k_delayed_work_init(&oob_work, oob_button_timeout);
	dk_buttons_init(oob_button_handler);
	button_press_count = true;
	return true;
}

static void input_complete(void)
{
	k_delayed_work_cancel(&oob_work);
}

static void prov_complete(u16_t net_idx, u16_t src)
{
	k_delayed_work_cancel(&oob_work);
	dk_buttons_init(NULL);
	printk("Prov complete! Addr: 0x%04x\n", src);
}

static void prov_reset(void)
{
	k_delayed_work_cancel(&oob_work);
	dk_buttons_init(NULL);
	bt_mesh_prov_enable(BT_MESH_PROV_ADV | BT_MESH_PROV_GATT);
}

static u8_t dev_uuid[16];

static const struct bt_mesh_prov prov = {
	.uuid = dev_uuid,
	.output_size = 1,
	.output_actions = BT_MESH_DISPLAY_NUMBER | BT_MESH_BLINK,
	.output_number = output_number,
	.input_size = 1,
	.input = input,
	.input_actions = BT_MESH_PUSH,
	.complete = prov_complete,
	.input_complete = input_complete,
	.reset = prov_reset,
};

const struct bt_mesh_prov *prov_handler_init(void)
{
	hwinfo_get_device_id(dev_uuid, sizeof(dev_uuid));
	return &prov;
}
```
