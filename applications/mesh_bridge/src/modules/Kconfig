## applications/mesh_bridge/src/modules/Kconfig
```kconfig
module = BRIDGE_UART
module-str = UART device
source "subsys/logging/Kconfig.template.log_config"

config BRIDGE_CDC_ENABLE
	bool "Enable USB CDC ACM"
	depends on USB
	select USB_CDC_ACM
	help
		This option enables USB CDC ACM
		and exposes two COM ports, bridging the two UART interfaces.

if BRIDGE_CDC_ENABLE

module = BRIDGE_CDC
module-str = USB CDC ACM device
source "subsys/logging/Kconfig.template.log_config"

endif

if DEVICE_POWER_MANAGEMENT

module = BRIDGE_POWER_MGMT
module-str = Bridge power management
source "subsys/logging/Kconfig.template.log_config"

endif

config BRIDGE_BUF_SIZE
	int "Transport interface buffer size"
	default 2048
	help
	  Size of transmit/receive buffer for transfer between interfaces.

config BRIDGE_UART_BUF_COUNT
	int "UART buffer block count"
	default 3
	range 3 255
	help
	  Number of buffer blocks assigned for UART instances.
	  This value is scaled with the number of interfaces.
	  With the default instance count of 2, and for example 3 buffers,
	  the total will be 6 buffers.
	  Note that all buffers are shared between UART instances.
```

## applications/mesh_controller/src/events/Kconfig
```kconfig
if LOG

menu "Event options"

comment "Initially logged events"

config MESH_CTL_INIT_LOG_BLE_PEER_EVENT
	bool "BLE peer event"
	default y

config MESH_CTL_INIT_LOG_MODULE_STATE_EVENT
	bool "Module state event"
	default y

endmenu

endif
```

## applications/mesh_controller/src/hw_interface/Kconfig
```kconfig
menu "Hardware interface modules"

rsource "Kconfig.buttons"

module = MESH_CTL_BOARD
module-str = board module
source "subsys/logging/Kconfig.template.log_config"

endmenu
```

## applications/mesh_controller/src/hw_interface/Kconfig.buttons
```kconfig
menu "Buttons configuration"

choice
	prompt "Select buttons interface"
	default MESH_CTL_BUTTONS_NONE

config MESH_CTL_BUTTONS_NONE
	bool "Disable buttons"

config MESH_CTL_BUTTONS_ENABLE
	bool "Buttons scanned from key matrix or directly connected GPIO"

endchoice

config MESH_CTL_BUTTONS_SCAN_INTERVAL
	int "Buttons scan interval in ms"
	depends on MESH_CTL_BUTTONS_ENABLE
	default 6
	help
	  Interval at which key matrix is scanned.

config MESH_CTL_BUTTONS_DEBOUNCE_INTERVAL
	int "Interval before first button scan in ms"
	depends on MESH_CTL_BUTTONS_ENABLE
	default 1
	help
	  Interval before first scan. Introduced for debouncing reasons.

config MESH_CTL_BUTTONS_POLARITY_INVERSED
	bool "Inverse buttons polarity"
	depends on MESH_CTL_BUTTONS_ENABLE
	help
	  When this option is enabled, button is pressed when the GPIO state
	  is low.

config MESH_CTL_BUTTONS_EVENT_LIMIT
	int "Number of button events in single scan loop"
	depends on MESH_CTL_BUTTONS_ENABLE
	default 4
	range 0 255
	help
	  This option specifies the number of button events generated during
	  a single scanning loop. If more keys change state between scanning
	  intervals, subsequent changes will be ignored and picked up during
	  the next scanning.

if !MESH_CTL_BUTTONS_NONE
module = MESH_CTL_BUTTONS
module-str = buttons module
source "subsys/logging/Kconfig.template.log_config"
endif

endmenu
```

## applications/mesh_controller/src/modules/Kconfig.ble
```kconfig
menu "BLE"

comment "BLE State"

module = MESH_CTL_BLE_STATE
module-str = BLE state
source "subsys/logging/Kconfig.template.log_config"

endmenu
```

## applications/mesh_sensor/src/hw_interface/Kconfig
```kconfig
menu "Hardware interface modules"

rsource "Kconfig.buttons"
rsource "Kconfig.leds"
rsource "Kconfig.battery_charger"
rsource "Kconfig.battery_meas"
rsource "Kconfig.sensors"

module = MESH_SENSOR_BOARD
module-str = board module
source "subsys/logging/Kconfig.template.log_config"

endmenu
```

## applications/mesh_sensor/src/hw_interface/Kconfig.battery_charger
```kconfig
menu "Battery charger configuration"

choice
	prompt "Select battery charging interface"
	default MESH_SENSOR_BATTERY_CHARGER_NONE

config MESH_SENSOR_BATTERY_CHARGER_NONE
	bool "No battery charging"

config MESH_SENSOR_BATTERY_CHARGER_DISCRETE
	bool "Discrete battery charger"

endchoice

config MESH_SENSOR_BATTERY_CHARGER_CSO_PIN
	int "Charging status pin"
	depends on MESH_SENSOR_BATTERY_CHARGER_DISCRETE
	help
	  A pin number to which CSO output is connected.

choice
	prompt "Select CSO pin pull"
	default MESH_SENSOR_BATTERY_CHARGER_CSO_PULL_NONE

config MESH_SENSOR_BATTERY_CHARGER_CSO_PULL_NONE
	bool "Disable CSO pin pull"

config MESH_SENSOR_BATTERY_CHARGER_CSO_PULL_UP
	bool "Enable CPO pin pull up"

config MESH_SENSOR_BATTERY_CHARGER_CSO_PULL_DOWN
	bool "Enable CSO pin pull down"

endchoice

config MESH_SENSOR_BATTERY_CHARGER_ENABLE_PIN
	int "Battery charging enable pin"
	depends on MESH_SENSOR_BATTERY_CHARGER_DISCRETE
	help
	  A pin which enables battery charging.

config MESH_SENSOR_BATTERY_CHARGER_ENABLE_INVERSED
	bool "Inverse charging enable signal"
	depends on MESH_SENSOR_BATTERY_CHARGER_DISCRETE
	help
	  Set this option if battery is charged when enable signal
	  is set to zero.

config MESH_SENSOR_BATTERY_CHARGER_CSO_FREQ
	int "CSO switching frequency (in Hz) on error state"
	depends on MESH_SENSOR_BATTERY_CHARGER_DISCRETE
	default 1000
	help
	  A frequency with which CSO pin switches state when charging
	  error occurs.

if !MESH_SENSOR_BATTERY_NONE
module = MESH_SENSOR_BATTERY_CHARGER
module-str = battery charger module
source "subsys/logging/Kconfig.template.log_config"
endif

endmenu
```

## applications/mesh_sensor/src/hw_interface/Kconfig.battery_meas
```kconfig
menu "Battery measurement configuration"

choice
	prompt "Select battery measurement"
	default MESH_SENSOR_BATTERY_MEAS_NONE

config MESH_SENSOR_BATTERY_MEAS_NONE
	bool "No battery measurement"

config MESH_SENSOR_BATTERY_MEAS
	bool "Enable battery measurement circuit"

endchoice

config MESH_SENSOR_BATTERY_MEAS_MIN_LEVEL
	int "Minimum battery voltage [mV] that corresponds to 0% level"
	depends on MESH_SENSOR_BATTERY_MEAS
	default 3100

config MESH_SENSOR_BATTERY_MEAS_MAX_LEVEL
	int "Maximum battery voltage [mV] that corresponds to 100% level"
	depends on MESH_SENSOR_BATTERY_MEAS
	default 4180

config MESH_SENSOR_BATTERY_MEAS_HAS_VOLTAGE_DIVIDER
	bool "Use voltage divider for battery measurement"
	depends on MESH_SENSOR_BATTERY_MEAS

config MESH_SENSOR_BATTERY_MEAS_VOLTAGE_DIVIDER_UPPER
	int "Upper resistor in battery measurement voltage divider [kOhm]"
	depends on MESH_SENSOR_BATTERY_MEAS_HAS_VOLTAGE_DIVIDER
	help
	  Output voltage is measured on the lower resistor.

config MESH_SENSOR_BATTERY_MEAS_VOLTAGE_DIVIDER_LOWER
	int "Lower resistor in battery measurement voltage divider [kOhm]"
	depends on MESH_SENSOR_BATTERY_MEAS_HAS_VOLTAGE_DIVIDER
	help
	  Output voltage is measured on the lower resistor.

config MESH_SENSOR_VOLTAGE_TO_SOC_DELTA
	int "Difference between adjacent elements in conversion LUT [mV]"
	depends on MESH_SENSOR_BATTERY_MEAS
	default 10
	range 1 100
	help
	  Value used to convert battery voltage [mV] to State of Charge [%].

config MESH_SENSOR_BATTERY_MEAS_POLL_INTERVAL_MS
	int "Time between the subsequent battery measurements [ms]"
	depends on MESH_SENSOR_BATTERY_MEAS
	default 10000
	range 500 120000

config MESH_SENSOR_BATTERY_MEAS_HAS_ENABLE_PIN
	bool "Use pin for enabling battery measurement"
	depends on MESH_SENSOR_BATTERY_MEAS

config MESH_SENSOR_BATTERY_MEAS_ENABLE_PIN
	int "Battery monitoring enable pin"
	depends on MESH_SENSOR_BATTERY_MEAS
	default 255 if !MESH_SENSOR_BATTERY_MEAS_HAS_ENABLE_PIN
	help
	  A pin which enables the battery measurement circuit.

if MESH_SENSOR_BATTERY_MEAS
module = MESH_SENSOR_BATTERY_MEAS
module-str = battery measurement module
source "subsys/logging/Kconfig.template.log_config"
endif

endmenu
```

## applications/mesh_sensor/src/hw_interface/Kconfig.leds
```kconfig
menu "LEDs configuration"

config MESH_SENSOR_LED_ENABLE
	bool "Enable LED hardware interface"

config MESH_SENSOR_LED_COUNT
	int "Number of LEDs in use"
	depends on MESH_SENSOR_LED_ENABLE
	default 0

config MESH_SENSOR_LED_COLOUR_COUNT
	int "Number of colour channels per diode"
	depends on MESH_SENSOR_LED_ENABLE
	default 3

config MESH_SENSOR_LED_BRIGHTNESS_MAX
	int "Maximum value for LED brightness"
	depends on MESH_SENSOR_LED_ENABLE
	default 255

if MESH_SENSOR_LED_ENABLE
module = MESH_SENSOR_LED
module-str = LED module
source "subsys/logging/Kconfig.template.log_config"
endif

endmenu
```

## applications/mesh_sensor/src/hw_interface/Kconfig.sensors
```kconfig
menu "Sensors configuration"

module = MESH_SENSOR_ENV_SENSORS
module-str = Sensors module
source "subsys/logging/Kconfig.template.log_config"

endmenu
```

## applications/mesh_sensor/src/modules/Kconfig
```kconfig
rsource "Kconfig.power_manager"
rsource "Kconfig.led_state"
rsource "Kconfig.ble"
rsource "Kconfig.settings_loader"
```

## applications/mesh_sensor/src/modules/Kconfig.ble
```kconfig
menu "BLE"

comment "BLE State"

module = MESH_SENSOR_BLE_STATE
module-str = BLE state
source "subsys/logging/Kconfig.template.log_config"

endmenu
```

## applications/mesh_sensor/src/modules/Kconfig.led_state
```kconfig
if MESH_SENSOR_LED_ENABLE

menu "LED state"

module = MESH_SENSOR_LED_STATE
module-str = LED state
source "subsys/logging/Kconfig.template.log_config"

endmenu

endif
```

## applications/mesh_sensor/src/modules/Kconfig.shell
```kconfig
if SHELL

menu "Shell module"

config MESH_SENSOR_SHELL_ENABLE
	bool "Enable shell module"
	default n
	depends on SHELL

config MESH_SENSOR_DEVICE_SHELL
	bool "Enable device information"
	depends on MESH_SENSOR_SHELL_ENABLE
	default n
	select DEVICE_SHELL

config MESH_SENSOR_KERNEL_SHELL
	bool "Enable kernel information"
	depends on MESH_SENSOR_SHELL_ENABLE
	select KERNEL_SHELL
	select THREAD_MONITOR
	select INIT_STACKS
	select THREAD_NAME

endmenu

endif
```

## applications/network_sensor/src/events/Kconfig
```kconfig
if LOG

menu "Event options"

comment "Initially logged events"

config NW_SNS_INIT_LOG_BUTTON_EVENT
	bool "Button event"
	default y

config NW_SNS_INIT_LOG_CONFIG_EVENT
	bool "Config event"
	default y

config NW_SNS_INIT_LOG_LED_EVENT
	bool "LED event"
	default y

config NW_SNS_INIT_LOG_MODULE_STATE_EVENT
	bool "Module state event"
	default y

config NW_SNS_INIT_LOG_POWER_DOWN_EVENT
	bool "Power down event"
	default y

config NW_SNS_INIT_LOG_WAKE_UP_EVENT
	bool "Wake up event"
	default y

config NW_SNS_INIT_LOG_USB_STATE_EVENT
	bool "USB state event"
	default y

endmenu

endif
```

## applications/network_sensor/src/hw_interface/Kconfig
```kconfig
menu "Hardware interface modules"

rsource "Kconfig.buttons"
rsource "Kconfig.leds"
rsource "Kconfig.display"

module = NW_SNS_BOARD
module-str = board module
source "subsys/logging/Kconfig.template.log_config"

endmenu
```

## applications/network_sensor/src/hw_interface/Kconfig.buttons
```kconfig
menu "Buttons configuration"

choice
	prompt "Select buttons interface"
	default NW_SNS_BUTTONS_NONE

config NW_SNS_BUTTONS_NONE
	bool "Disable buttons"

config NW_SNS_BUTTONS_ENABLE
	bool "Buttons scanned from key matrix or directly connected GPIO"

endchoice

config NW_SNS_BUTTONS_SCAN_INTERVAL
	int "Buttons scan interval in ms"
	depends on NW_SNS_BUTTONS_ENABLE
	default 2
	help
	  Interval at which key matrix is scanned.

config NW_SNS_BUTTONS_DEBOUNCE_INTERVAL
	int "Interval before first button scan in ms"
	depends on NW_SNS_BUTTONS_ENABLE
	default 2
	help
	  Interval before first scan. Introduced for debouncing reasons.

config NW_SNS_BUTTONS_POLARITY_INVERSED
	bool "Inverse buttons polarity"
	depends on NW_SNS_BUTTONS_ENABLE
	help
	  When this option is enabled, button is pressed when the GPIO state
	  is low.

config NW_SNS_BUTTONS_EVENT_LIMIT
	int "Number of button events in single scan loop"
	depends on NW_SNS_BUTTONS_ENABLE
	default 4
	range 0 255
	help
	  This option specifies the number of button events generated during
	  a single scanning loop. If more keys change state between scanning
	  intervals, subsequent changes will be ignored and picked up during
	  the next scanning.

config NW_SNS_BUTTONS_SIM_ENABLE
	bool "Enable simulated button presses generator"
	depends on !NW_SNS_BUTTONS_NONE

config NW_SNS_BUTTONS_SIM_INTERVAL
	int "Interval between subsequent simulated button presses [ms]"
	depends on NW_SNS_BUTTONS_SIM_ENABLE
	default 1000
	range 1 60000

config NW_SNS_BUTTONS_SIM_LOOP_FOREVER
	bool "Generate buttons in infinite loop"
	depends on NW_SNS_BUTTONS_SIM_ENABLE
	help
	  When this option is disabled sequence of buttons is generated once.
	  Enabling this option makes the sequence start from the beginning
	  after it ends.

config NW_SNS_BUTTONS_SIM_TRIGGER_KEY_ID
	hex "Button used to start/stop generating button presses"
	depends on NW_SNS_BUTTONS_SIM_ENABLE
	default 0x0000

if !NW_SNS_BUTTONS_NONE
module = NW_SNS_BUTTONS
module-str = buttons module
source "subsys/logging/Kconfig.template.log_config"
endif

endmenu
```

## applications/network_sensor/src/hw_interface/Kconfig.display
```kconfig
menu "Display configuration"

choice
	prompt "Select display interface"
	default NW_SNS_DISPLAY_NONE

config NW_SNS_DISPLAY_NONE
	bool "Disable display"

config NW_SNS_DISPLAY_TEXT
	bool "Display is a character display"
        select DISPLAY
        select CHARACTER_FRAMEBUFFER
        select CHARACTER_FRAMEBUFFER_SHELL if SHELL

config NW_SNS_DISPLAY_GRAPHICS
	bool "Display is a full graphic display"
        select DISPLAY
        select LVGL
#        select LVGL_DISPLAY_DEV_NAME="SSD1306"
#        select LVGL_HOR_RES=128
#        select LVGL_VER_RES=32
#        select LVGL_VDB_SIZE=64
#        select LVGL_DPI=148
#        select LVGL_BITS_PER_PIXEL=1
#        select LVGL_COLOR_DEPTH_1

endchoice

if !NW_SNS_DISPLAY_NONE
module = NW_SNS_DISPLAY
module-str = display module
source "subsys/logging/Kconfig.template.log_config"
endif

endmenu
```

## applications/network_sensor/src/hw_interface/Kconfig.leds
```kconfig
menu "LEDs configuration"

config NW_SNS_LED_ENABLE
	bool "Enable LED hardware interface"

config NW_SNS_LED_COUNT
	int "Number of LEDs in use"
	depends on NW_SNS_LED_ENABLE
	default 0

config NW_SNS_LED_COLOUR_COUNT
	int "Number of colour channels per diode"
	depends on NW_SNS_LED_ENABLE
	default 3

config NW_SNS_LED_BRIGHTNESS_MAX
	int "Maximum value for LED brightness"
	depends on NW_SNS_LED_ENABLE
	default 255

if NW_SNS_LED_ENABLE
module = NW_SNS_LED
module-str = LED module
source "subsys/logging/Kconfig.template.log_config"
endif

endmenu
```

## applications/network_sensor/src/modules/Kconfig.settings_loader
```kconfig
menu "Settings loading service"

config NW_SNS_SETTINGS_LOADER_USE_THREAD
	bool "Enable loading of setting by separate thead"
        depends on SETTINGS
	help
	  The option enables loading of settings by separate
	  thread in background instead of use of system
	  work queue for that purpose.

config NW_SNS_SETTINGS_LOADER_THREAD_STACK_SIZE
	int "Settings module thread stack size"
        depends on NW_SNS_SETTINGS_LOADER_USE_THREAD
	range 0 4096
	default 1024
	help
	  Stack size for thread responsible for loading
	  settings from flash memory.

if !NW_SNS_SETTINGS_LOADER_USE_THREAD
config NW_SNS_SETTINGS_LOADER_THREAD_STACK_SIZE
	int
	default 0
endif

if SETTINGS

module = NW_SNS_SETTINGS_LOADER
module-str = Settings loader
source "subsys/logging/Kconfig.template.log_config"

endif

endmenu
```

## applications/network_sensor/src/modules/Kconfig.usb_state
```kconfig
if USB

menu "USB state"

config NW_SNS_USB_ENABLE
	bool "Enable USB module"
	default n
	help
	  Enables USB module.

if NW_SNS_USB_ENABLE

module = NW_SNS_USB_STATE
module-str = USB state
source "subsys/logging/Kconfig.template.log_config"

endif

endmenu

endif
```
