## boards/shields/oled_featherwing/Kconfig.defconfig
```kconfig
if SHIELD_OLED_FEATHERWING

if DISPLAY

config I2C
	default y

config SSD1306
	default y

if LVGL

config LVGL_DISPLAY_DEV_NAME
	default "SSD1306"

config LVGL_HOR_RES
	default 128

config LVGL_VER_RES
	default 32

config LVGL_VDB_SIZE
	default 64

config LVGL_DPI
	default 148

config LVGL_BITS_PER_PIXEL
	default 1

choice LVGL_COLOR_DEPTH
	default LVGL_COLOR_DEPTH_1
endchoice

endif # LVGL

endif # DISPLAY

endif # SHIELD_OLED_FEATHERWING
```

## boards/shields/oled_featherwing/Kconfig.shield
```kconfig
config SHIELD_OLED_FEATHERWING
	def_bool $(shields_list_contains,oled_featherwing)
```

## drivers/Kconfig
```kconfig
menu "Device Drivers"

rsource "seesaw/Kconfig"
rsource "sensor/Kconfig"

if BT_LL_NRFXLIB
rsource "bt_ll_nrfxlib/Kconfig"
endif
if MPSL
rsource "mpsl/Kconfig"
endif

endmenu
```

## drivers/seesaw/Kconfig
```kconfig
# Kconfig - Adafruit SeeSaw sensor driver

menuconfig SEESAW
	bool "SeeSaw driver"
        depends on I2C && HAS_DTS_I2C && HAS_DTS_GPIO
	help
	  Enable SeeSaw driver.

if SEESAW

choice
	prompt "Trigger mode"
	default SEESAW_TRIGGER_NONE
	help
	  Specify the type of triggering used by the driver.

config SEESAW_TRIGGER_NONE
	bool "No trigger"

config SEESAW_TRIGGER_GLOBAL_THREAD
	bool "Use global thread"
	depends on GPIO
	select SEESAW_TRIGGER

config SEESAW_TRIGGER_OWN_THREAD
	bool "Use own thread"
	depends on GPIO
	select SEESAW_TRIGGER

endchoice

config SEESAW_TRIGGER
	bool

config SEESAW_THREAD_PRIORITY
	int "Thread priority"
	depends on SEESAW_TRIGGER_OWN_THREAD && SEESAW_TRIGGER
	default 10
	help
	  Priority of thread used by the driver to handle interrupts.

config SEESAW_THREAD_STACK_SIZE
	int "Thread stack size"
	depends on SEESAW_TRIGGER_OWN_THREAD && SEESAW_TRIGGER
	default 1024
	help
	  Stack size of thread used by the driver to handle interrupts.

endif #SEESAW
```

## drivers/sensor/Kconfig
```kconfig
menuconfig SENSOR
	bool "Sensor Drivers"
	help
		Include sensor drivers in config

if SENSOR

rsource "sensor_sim/Kconfig"

endif # SENSOR
```

## drivers/sensor/seesaw/Kconfig
```kconfig
# Kconfig - SeeSaw sensor driver

menuconfig SEESAW
	bool "SeeSaw driver"
	help
	  Enable SeeSaw driver.

if SEESAW

module = SEESAW
module-str = SeeSaw
source "${ZEPHYR_BASE}/subsys/logging/Kconfig.template.log_config"

endif #SEESAW
```

## dts/bindings/adafruit,seesaw.yaml
```yaml
title: Adafruit SeeSaw I/O expander

description: >
    This is a representation of the Adafruit SeeSaw sensor

compatible: "adafruit,seesaw"

include: i2c-device.yaml

properties:
    int-gpios:
      type: phandle-array
      required: true
```

## lib/Kconfig
```kconfig
menu "Libraries"
rsource "flash_patch/Kconfig"
rsource "fprotect/Kconfig"
rsource "dk_buttons_and_leds/Kconfig"

rsource "multithreading_lock/Kconfig"
rsource "fatal_error/Kconfig"
rsource "date_time/Kconfig"

endmenu
```

## subsys/Kconfig
```kconfig
rsource "bluetooth/Kconfig"

rsource "event_manager/Kconfig"

rsource "fw_info/Kconfig"

rsource "debug/Kconfig"

rsource "shell/Kconfig"
```

## west.yml
```yaml
manifest:
  defaults:
    remote: zephyrproject

  remotes:
    - name: zephyrproject
      url-base: https://github.com/zephyrproject-rtos
    - name: ncs
      url-base: https://github.com/nrfconnect
    - name: rosterloh
      url-base: git@github.com:rosterloh/nrf-projects.git

  projects:
    - name: zephyr
      revision: master
      west-commands: scripts/west-commands.yml
      import:
        name-whitelist:
          - cmsis
          - hal_nordic
          - lvgl
          - mbedtls
          - mcuboot
          - mcumgr
          - segger
          - tinycbor
          - tinycrypt
          - littlefs
          - nrf_hw_models

    - name: nrfxlib
      repo-path: sdk-nrfxlib
      revision: fa0bd769387f7627d41c6592ae4c2f449847b822
      path: nrfxlib
      remote: ncs

  self:
    path: nrf
```
